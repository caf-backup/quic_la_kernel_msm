## Documentation/devicetree/bindings/interrupt-controller/interrupts.txt
```
Specifying interrupt information for devices
============================================

1) Interrupt client nodes
-------------------------

Nodes that describe devices which generate interrupts must contain an
"interrupts" property, an "interrupts-extended" property, or both. If both are
present, the latter should take precedence; the former may be provided simply
for compatibility with software that does not recognize the latter. These
properties contain a list of interrupt specifiers, one per output interrupt. The
format of the interrupt specifier is determined by the interrupt controller to
which the interrupts are routed; see section 2 below for details.

  Example:
	interrupt-parent = <&intc1>;
	interrupts = <5 0>, <6 0>;

The "interrupt-parent" property is used to specify the controller to which
interrupts are routed and contains a single phandle referring to the interrupt
controller node. This property is inherited, so it may be specified in an
interrupt client node or in any of its parent nodes. Interrupts listed in the
"interrupts" property are always in reference to the node's interrupt parent.

The "interrupts-extended" property is a special form for use when a node needs
to reference multiple interrupt parents. Each entry in this property contains
both the parent phandle and the interrupt specifier. "interrupts-extended"
should only be used when a device has multiple interrupt parents.

  Example:
	interrupts-extended = <&intc1 5 1>, <&intc2 1 0>;

2) Interrupt controller nodes
-----------------------------

A device is marked as an interrupt controller with the "interrupt-controller"
property. This is a empty, boolean property. An additional "#interrupt-cells"
property defines the number of cells needed to specify a single interrupt.

It is the responsibility of the interrupt controller's binding to define the
length and format of the interrupt specifier. The following two variants are
commonly used:

  a) one cell
  -----------
  The #interrupt-cells property is set to 1 and the single cell defines the
  index of the interrupt within the controller.

  Example:

	vic: intc@10140000 {
		compatible = "arm,versatile-vic";
		interrupt-controller;
		#interrupt-cells = <1>;
		reg = <0x10140000 0x1000>;
	};

	sic: intc@10003000 {
		compatible = "arm,versatile-sic";
		interrupt-controller;
		#interrupt-cells = <1>;
		reg = <0x10003000 0x1000>;
		interrupt-parent = <&vic>;
		interrupts = <31>; /* Cascaded to vic */
	};

  b) two cells
  ------------
  The #interrupt-cells property is set to 2 and the first cell defines the
  index of the interrupt within the controller, while the second cell is used
  to specify any of the following flags:
    - bits[3:0] trigger type and level flags
        1 = low-to-high edge triggered
        2 = high-to-low edge triggered
        4 = active high level-sensitive
        8 = active low level-sensitive

  Example:

	i2c@7000c000 {
		gpioext: gpio-adnp@41 {
			compatible = "ad,gpio-adnp";
			reg = <0x41>;

			interrupt-parent = <&gpio>;
			interrupts = <160 1>;

			gpio-controller;
			#gpio-cells = <1>;

			interrupt-controller;
			#interrupt-cells = <2>;

			nr-gpios = <64>;
		};

		sx8634@2b {
			compatible = "smtc,sx8634";
			reg = <0x2b>;

			interrupt-parent = <&gpioext>;
			interrupts = <3 0x8>;

			#address-cells = <1>;
			#size-cells = <0>;

			threshold = <0x40>;
			sensitivity = <7>;
		};
	};

3) Interrupt wakeup parent
--------------------------

Some interrupt controllers in a SoC, are always powered on and have a select
interrupts routed to them, so that they can wakeup the SoC from suspend. These
interrupt controllers do not fall into the category of a parent interrupt
controller and can be specified by the "wakeup-parent" property and contain a
single phandle referring to the wakeup capable interrupt controller.

   Example:
	wakeup-parent = <&pdc_intc>;


4) Interrupt mapping
--------------------

Sometimes interrupts may be detected by more than one interrupt controller
(depending on which controller is active). The interrupt controllers may not
be in hierarchy and therefore the interrupt controller driver is required to
establish the relationship between the same interrupt at different interrupt
controllers. If these interrupts are not sequential then a map needs to be
specified to help identify these interrupts.

Mapping the interrupt specifiers in the device tree can be done using the
"irqdomain-map" property. The property contains interrupt specifier at the
current interrupt controller followed by the interrupt specifier at the mapped
interrupt controller.

   irqdomain-map = <incoming-interrupt-specifier mapped-interrupt-specifier>

The optional properties "irqdomain-map-mask" and "irqdomain-map-pass-thru" may
be provided to help interpret the valid bits of the incoming and mapped
interrupt specifiers respectively.

   Example:
	intc: interrupt-controller@17a00000 {
		#interrupt-cells = <3>;
	};

	pinctrl@3400000 {
		#interrupt-cells = <2>;
		irqdomain-map = <22 0 &intc 36 0>, <24 0 &intc 37 0>;
		irqdomain-map-mask = <0xff 0>;
		irqdomain-map-pass-thru = <0 0xff>;
	};

In the above example, the input interrupt specifier map-mask <0xff 0> applied
on the incoming interrupt specifier of the map <22 0>, <24 0>, returns the
input interrupt 22, 24 etc. The second argument being irq type is immaterial
from the map and is used from the incoming request instead. The pass-thru
specifier parses the output interrupt specifier from the rest of the unparsed
argments from the map <&intc 36 0>, <&intc 37 0> etc to return the output
interrupt 36, 37 etc.
```

## Documentation/devicetree/bindings/pinctrl/qcom,sdm845-pinctrl.txt
```
Qualcomm SDM845 TLMM block

This binding describes the Top Level Mode Multiplexer block found in the
SDM845 platform.

- compatible:
	Usage: required
	Value type: <string>
	Definition: must be "qcom,sdm845-pinctrl"

- reg:
	Usage: required
	Value type: <prop-encoded-array>
	Definition: the base address and size of the TLMM register space.

- interrupts-extended:
	Usage: required
	Value type: <prop-encoded-array>
	Definition: should specify the TLMM summary IRQ as the first
		    interrupt. Optionally, wake up capable GPIOs may list
		    their corresponding PDC interrupts here.

- interrupt-names:
	Usage: required
	Value type: <string>
	Definition: the names matching the interrupt definition in the
		    interrupts-extended property. The first interrupt name
		    must be "summary-irq" for the TLMM summary IRQ. PDC
		    interrupts must be described by "gpioN", where N is the
		    GPIO line corresponding to the PDC IRQ.

- interrupt-controller:
	Usage: required
	Value type: <none>
	Definition: identifies this node as an interrupt controller

- #interrupt-cells:
	Usage: required
	Value type: <u32>
	Definition: must be 2. Specifying the pin number and flags, as defined
		    in <dt-bindings/interrupt-controller/irq.h>

- gpio-controller:
	Usage: required
	Value type: <none>
	Definition: identifies this node as a gpio controller

- #gpio-cells:
	Usage: required
	Value type: <u32>
	Definition: must be 2. Specifying the pin number and flags, as defined
		    in <dt-bindings/gpio/gpio.h>

Please refer to ../gpio/gpio.txt and ../interrupt-controller/interrupts.txt for
a general description of GPIO and interrupt bindings.

Please refer to pinctrl-bindings.txt in this directory for details of the
common pinctrl bindings used by client devices, including the meaning of the
phrase "pin configuration node".

The pin configuration nodes act as a container for an arbitrary number of
subnodes. Each of these subnodes represents some desired configuration for a
pin, a group, or a list of pins or groups. This configuration can include the
mux function to select on those pin(s)/group(s), and various pin configuration
parameters, such as pull-up, drive strength, etc.


PIN CONFIGURATION NODES:

The name of each subnode is not important; all subnodes should be enumerated
and processed purely based on their content.

Each subnode only affects those parameters that are explicitly listed. In
other words, a subnode that lists a mux function but no pin configuration
parameters implies no information about any pin configuration parameters.
Similarly, a pin subnode that describes a pullup parameter implies no
information about e.g. the mux function.


The following generic properties as defined in pinctrl-bindings.txt are valid
to specify in a pin configuration subnode:

- pins:
	Usage: required
	Value type: <string-array>
	Definition: List of gpio pins affected by the properties specified in
		    this subnode.

		    Valid pins are:
		      gpio0-gpio149
		        Supports mux, bias and drive-strength

		      sdc2_clk, sdc2_cmd, sdc2_data
		        Supports bias and drive-strength

- function:
	Usage: required
	Value type: <string>
	Definition: Specify the alternative function to be configured for the
		    specified pins. Functions are only valid for gpio pins.
		    Valid values are:

		    gpio, adsp_ext, agera_pll, atest_char, atest_tsens,
		    atest_tsens2, atest_usb1, atest_usb10, atest_usb11,
		    atest_usb12, atest_usb13, atest_usb2, atest_usb20,
		    atest_usb21, atest_usb22, atest_usb23, audio_ref,
		    btfm_slimbus, cam_mclk, cci_async, cci_i2c, cci_timer0,
		    cci_timer1, cci_timer2, cci_timer3, cci_timer4, cri_trng,
		    cri_trng0, cri_trng1, dbg_out, ddr_bist, ddr_pxi0,
		    ddr_pxi1, ddr_pxi2, ddr_pxi3, edp_hot, edp_lcd, gcc_gp1,
		    gcc_gp2, gcc_gp3, jitter_bist, ldo_en, ldo_update,
		    lpass_slimbus, m_voc, mdp_vsync, mdp_vsync0, mdp_vsync1,
		    mdp_vsync2, mdp_vsync3, mss_lte, nav_pps, pa_indicator,
		    pci_e0, pci_e1, phase_flag, pll_bist, pll_bypassnl,
		    pll_reset, pri_mi2s, pri_mi2s_ws, prng_rosc, qdss_cti,
		    qdss, qlink_enable, qlink_request, qua_mi2s, qup0, qup1,
		    qup10, qup11, qup12, qup13, qup14, qup15, qup2, qup3, qup4,
		    qup5, qup6, qup7, qup8, qup9, qup_l4, qup_l5, qup_l6,
		    qspi_clk, qspi_cs, qspi_data, sd_write, sdc4_clk, sdc4_cmd,
		    sdc4_data, sec_mi2s, sp_cmu, spkr_i2s, ter_mi2s, tgu_ch0,
		    tgu_ch1, tgu_ch2, tgu_ch3, tsense_pwm1, tsense_pwm2,
		    tsif1_clk, tsif1_data, tsif1_en, tsif1_error, tsif1_sync,
		    tsif2_clk, tsif2_data, tsif2_en, tsif2_error, tsif2_sync,
		    uim1_clk, uim1_data, uim1_present, uim1_reset, uim2_clk,
		    uim2_data, uim2_present, uim2_reset, uim_batt, usb_phy,
		    vfr_1, vsense_trigger, wlan1_adc0, wlan1_adc1, wlan2_adc0,
		    wlan2_adc1,

- bias-disable:
	Usage: optional
	Value type: <none>
	Definition: The specified pins should be configued as no pull.

- bias-pull-down:
	Usage: optional
	Value type: <none>
	Definition: The specified pins should be configued as pull down.

- bias-pull-up:
	Usage: optional
	Value type: <none>
	Definition: The specified pins should be configued as pull up.

- output-high:
	Usage: optional
	Value type: <none>
	Definition: The specified pins are configured in output mode, driven
		    high.
		    Not valid for sdc pins.

- output-low:
	Usage: optional
	Value type: <none>
	Definition: The specified pins are configured in output mode, driven
		    low.
		    Not valid for sdc pins.

- drive-strength:
	Usage: optional
	Value type: <u32>
	Definition: Selects the drive strength for the specified pins, in mA.
		    Valid values are: 2, 4, 6, 8, 10, 12, 14 and 16

Example:

	tlmm: pinctrl@3400000 {
		compatible = "qcom,sdm845-pinctrl";
		reg = <0x03400000 0xc00000>;
		gpio-controller;
		#gpio-cells = <2>;
		interrupt-controller;
		#interrupt-cells = <2>;
		interrupts-extended =
			<&intc GIC_SPI 208 IRQ_TYPE_LEVEL_HIGH>,
			<&pdc 30 IRQ_TYPE_LEVEL_HIGH>,
			<&pdc 31 IRQ_TYPE_LEVEL_HIGH>,
			<&pdc 32 IRQ_TYPE_LEVEL_HIGH>,
			<&pdc 33 IRQ_TYPE_LEVEL_HIGH>,
			<&pdc 34 IRQ_TYPE_LEVEL_HIGH>,
			<&pdc 35 IRQ_TYPE_LEVEL_HIGH>,
			<&pdc 36 IRQ_TYPE_LEVEL_HIGH>,
			<&pdc 37 IRQ_TYPE_LEVEL_HIGH>,
			<&pdc 38 IRQ_TYPE_LEVEL_HIGH>,
			<&pdc 39 IRQ_TYPE_LEVEL_HIGH>,
			<&pdc 41 IRQ_TYPE_LEVEL_HIGH>,
			<&pdc 42 IRQ_TYPE_LEVEL_HIGH>,
			<&pdc 43 IRQ_TYPE_LEVEL_HIGH>,
			<&pdc 44 IRQ_TYPE_LEVEL_HIGH>,
			<&pdc 45 IRQ_TYPE_LEVEL_HIGH>,
			<&pdc 46 IRQ_TYPE_LEVEL_HIGH>,
			<&pdc 47 IRQ_TYPE_LEVEL_HIGH>,
			<&pdc 49 IRQ_TYPE_LEVEL_HIGH>,
			<&pdc 50 IRQ_TYPE_LEVEL_HIGH>,
			<&pdc 51 IRQ_TYPE_LEVEL_HIGH>,
			<&pdc 52 IRQ_TYPE_LEVEL_HIGH>,
			<&pdc 54 IRQ_TYPE_LEVEL_HIGH>,
			<&pdc 55 IRQ_TYPE_LEVEL_HIGH>,
			<&pdc 56 IRQ_TYPE_LEVEL_HIGH>,
			<&pdc 57 IRQ_TYPE_LEVEL_HIGH>,
			<&pdc 58 IRQ_TYPE_LEVEL_HIGH>,
			<&pdc 59 IRQ_TYPE_LEVEL_HIGH>,
			<&pdc 60 IRQ_TYPE_LEVEL_HIGH>,
			<&pdc 61 IRQ_TYPE_LEVEL_HIGH>,
			<&pdc 62 IRQ_TYPE_LEVEL_HIGH>,
			<&pdc 63 IRQ_TYPE_LEVEL_HIGH>,
			<&pdc 64 IRQ_TYPE_LEVEL_HIGH>,
			<&pdc 65 IRQ_TYPE_LEVEL_HIGH>,
			<&pdc 66 IRQ_TYPE_LEVEL_HIGH>,
			<&pdc 67 IRQ_TYPE_LEVEL_HIGH>,
			<&pdc 68 IRQ_TYPE_LEVEL_HIGH>,
			<&pdc 69 IRQ_TYPE_LEVEL_HIGH>,
			<&pdc 70 IRQ_TYPE_LEVEL_HIGH>,
			<&pdc 71 IRQ_TYPE_LEVEL_HIGH>,
			<&pdc 72 IRQ_TYPE_LEVEL_HIGH>,
			<&pdc 73 IRQ_TYPE_LEVEL_HIGH>,
			<&pdc 74 IRQ_TYPE_LEVEL_HIGH>,
			<&pdc 75 IRQ_TYPE_LEVEL_HIGH>,
			<&pdc 76 IRQ_TYPE_LEVEL_HIGH>,
			<&pdc 77 IRQ_TYPE_LEVEL_HIGH>,
			<&pdc 79 IRQ_TYPE_LEVEL_HIGH>,
			<&pdc 80 IRQ_TYPE_LEVEL_HIGH>,
			<&pdc 81 IRQ_TYPE_LEVEL_HIGH>,
			<&pdc 82 IRQ_TYPE_LEVEL_HIGH>,
			<&pdc 83 IRQ_TYPE_LEVEL_HIGH>,
			<&pdc 84 IRQ_TYPE_LEVEL_HIGH>,
			<&pdc 85 IRQ_TYPE_LEVEL_HIGH>,
			<&pdc 86 IRQ_TYPE_LEVEL_HIGH>,
			<&pdc 90 IRQ_TYPE_LEVEL_HIGH>,
			<&pdc 91 IRQ_TYPE_LEVEL_HIGH>,
			<&pdc 92 IRQ_TYPE_LEVEL_HIGH>,
			<&pdc 95 IRQ_TYPE_LEVEL_HIGH>,
			<&pdc 96 IRQ_TYPE_LEVEL_HIGH>,
			<&pdc 97 IRQ_TYPE_LEVEL_HIGH>,
			<&pdc 98 IRQ_TYPE_LEVEL_HIGH>,
			<&pdc 99 IRQ_TYPE_LEVEL_HIGH>,
			<&pdc 100 IRQ_TYPE_LEVEL_HIGH>,
			<&pdc 102 IRQ_TYPE_LEVEL_HIGH>,
			<&pdc 103 IRQ_TYPE_LEVEL_HIGH>,
			<&pdc 104 IRQ_TYPE_LEVEL_HIGH>,
			<&pdc 105 IRQ_TYPE_LEVEL_HIGH>,
			<&pdc 106 IRQ_TYPE_LEVEL_HIGH>,
			<&pdc 107 IRQ_TYPE_LEVEL_HIGH>,
			<&pdc 108 IRQ_TYPE_LEVEL_HIGH>;
		interrupt-names = "summary-irq",
			"gpio1", "gpio3", "gpio5", "gpio10", "gpio11",
			"gpio20", "gpio22", "gpio24", "gpio26", "gpio30",
			"gpio32", "gpio34", "gpio36", "gpio37", "gpio38",
			"gpio39", "gpio40", "gpio43", "gpio44", "gpio46",
			"gpio48", "gpio52", "gpio53", "gpio54", "gpio56",
			"gpio57", "gpio58", "gpio59", "gpio60", "gpio61",
			"gpio62", "gpio63", "gpio64", "gpio66", "gpio68",
			"gpio71", "gpio73", "gpio77", "gpio78", "gpio79",
			"gpio80", "gpio84", "gpio85", "gpio86", "gpio88",
			"gpio91", "gpio92", "gpio95", "gpio96", "gpio97",
			"gpio101", "gpio103", "gpio104", "gpio115", "gpio116",
			"gpio117", "gpio118", "gpio119", "gpio120", "gpio121",
			"gpio122", "gpio123", "gpio124", "gpio125", "gpio127",
			"gpio128", "gpio129", "gpio130", "gpio132", "gpio133",
			"gpio145", "gpio41", "gpio89", "gpio31", "gpio49",
			"gpio41", "gpio89", "gpio31", "gpio49";

		qup9_active: qup9-active {
			mux {
				pins = "gpio4", "gpio5";
				function = "qup9";
			};

			config {
				pins = "gpio4", "gpio5";
				drive-strength = <2>;
				bias-disable;
			};
		};
	};
```
