## Documentation/devicetree/bindings/arm/ipq.txt
```
QCA IPQ device tree bindings
---------------------------------

System on Chip

Device tree must specify which SoC it uses, with one of the
following compatible strings

	"qcom,qca961x"

Platform

Device tree must specify which Platform it uses, with one of the
following compatible strings

	"qcom,qca961x-r3pc"
	"qcom,ipq40xx-apdk01.1"
```

## Documentation/devicetree/bindings/arm/msm/imem.txt
```
Qualcomm IMEM

IMEM is fast on-chip memory used for various debug features and dma transactions.

Required properties

-compatible: "qcom,msm-imem"
-reg: start address and size of imem memory

If any children nodes exist the following properties are required:
-#address-cells: should be 1
-#size-cells: should be 1
-ranges: A triplet that includes the child address, parent address, &
     length.  The child address is assumed to be 0.

Child nodes:
------------

Download Mode Type:
-------------------
Required properties:
-compatible: "qcom,msm-imem-diag-dload"
-reg: start address and size of dload type region in imem
```

## Documentation/devicetree/bindings/arm/psci.txt
```
* Power State Coordination Interface (PSCI)

Firmware implementing the PSCI functions described in ARM document number
ARM DEN 0022A ("Power State Coordination Interface System Software on ARM
processors") can be used by Linux to initiate various CPU-centric power
operations.

Issue A of the specification describes functions for CPU suspend, hotplug
and migration of secure software.

Functions are invoked by trapping to the privilege level of the PSCI
firmware (specified as part of the binding below) and passing arguments
in a manner similar to that specified by AAPCS:

	 r0		=> 32-bit Function ID / return value
	{r1 - r3}	=> Parameters

Note that the immediate field of the trapping instruction must be set
to #0.


Main node required properties:

 - compatible    : should contain at least one of:

     * "arm,psci"     : For implementations complying to PSCI versions prior
			to 0.2.
			For these cases function IDs must be provided.

     * "arm,psci-0.2" : For implementations complying to PSCI 0.2.
			Function IDs are not required and should be ignored by
			an OS with PSCI 0.2 support, but are permitted to be
			present for compatibility with existing software when
			"arm,psci" is later in the compatible list.

     * "arm,psci-1.0" : For implementations complying to PSCI 1.0.
			PSCI 1.0 is backward compatible with PSCI 0.2 with
			minor specification updates, as defined in the PSCI
			specification[2].

 - method        : The method of calling the PSCI firmware. Permitted
                   values are:

                   "smc" : SMC #0, with the register assignments specified
		           in this binding.

                   "hvc" : HVC #0, with the register assignments specified
		           in this binding.

Main node optional properties:

 - cpu_suspend   : Function ID for CPU_SUSPEND operation

 - cpu_off       : Function ID for CPU_OFF operation

 - cpu_on        : Function ID for CPU_ON operation

 - migrate       : Function ID for MIGRATE operation

Device tree nodes that require usage of PSCI CPU_SUSPEND function (ie idle
state nodes, as per bindings in [1]) must specify the following properties:

- arm,psci-suspend-param
		Usage: Required for state nodes[1] if the corresponding
                       idle-states node entry-method property is set
                       to "psci".
		Value type: <u32>
		Definition: power_state parameter to pass to the PSCI
			    suspend call.

Example:

Case 1: PSCI v0.1 only.

	psci {
		compatible	= "arm,psci";
		method		= "smc";
		cpu_suspend	= <0x95c10000>;
		cpu_off		= <0x95c10001>;
		cpu_on		= <0x95c10002>;
		migrate		= <0x95c10003>;
	};

Case 2: PSCI v0.2 only

	psci {
		compatible	= "arm,psci-0.2";
		method		= "smc";
	};

Case 3: PSCI v0.2 and PSCI v0.1.

	A DTB may provide IDs for use by kernels without PSCI 0.2 support,
	enabling firmware and hypervisors to support existing and new kernels.
	These IDs will be ignored by kernels with PSCI 0.2 support, which will
	use the standard PSCI 0.2 IDs exclusively.

	psci {
		compatible = "arm,psci-0.2", "arm,psci";
		method = "hvc";

		cpu_on = < arbitrary value >;
		cpu_off = < arbitrary value >;

		...
	};

ARM systems can have multiple cores sometimes in hierarchical arrangement.
This often, but not always, maps directly to the processor power topology of
the system. Individual nodes in a topology have their own specific power states
and can be better represented in DT hierarchically.

For these cases, the definitions of the idle states for the CPUs and the CPU
topology, must conform to the domain idle state specification [3]. The domain
idle states themselves, must be compatible with the defined 'domain-idle-state'
binding [1], and also need to specify the arm,psci-suspend-param property for
each idle state.

DT allows representing CPUs and CPU idle states in two different ways -

The flattened model as given in Example 1, lists CPU's idle states followed by
the domain idle state that the CPUs may choose. Note that the idle states are
all compatible with "arm,idle-state". Additionally, for the domain idle state
the "arm,psci-suspend-param" represents a superset of the CPU's idle state.

Example 2 represents the hierarchical model of CPUs and domain idle states.
CPUs define their domain provider in their psci DT node. The domain controls
the power to the CPU and possibly other h/w blocks that would enter an idle
state along with the CPU. The CPU's idle states may therefore be considered as
the domain's idle states and have the compatible "arm,idle-state". Such domains
may also be embedded within another domain that may represent common h/w blocks
between these CPUs. The idle states of the CPU topology shall be represented as
the domain's idle states. Note that for the domain idle state, the
"arm,psci-suspend-param" represents idle states hierarchically.

In PSCI firmware v1.0, the OS-Initiated mode is introduced. However, the
flattened vs hierarchical DT representation is orthogonal to the OS-Initiated
vs the platform-coordinated PSCI CPU suspend modes, thus should be considered
independent of each other.

The hierarchical representation helps and makes it easy to implement OSI mode
and OS implementations may choose to mandate it. For the default platform-
coordinated mode, both representations are viable options.

Example 1: Flattened representation of CPU and domain idle states
	cpus {
		#address-cells = <1>;
		#size-cells = <0>;

		CPU0: cpu@0 {
			device_type = "cpu";
			compatible = "arm,cortex-a53", "arm,armv8";
			reg = <0x0>;
			enable-method = "psci";
			cpu-idle-states = <&CPU_PWRDN>, <&CLUSTER_RET>,
					  <&CLUSTER_PWRDN>;
		};

		CPU1: cpu@1 {
			device_type = "cpu";
			compatible = "arm,cortex-a57", "arm,armv8";
			reg = <0x100>;
			enable-method = "psci";
			cpu-idle-states = <&CPU_PWRDN>, <&CLUSTER_RET>,
					  <&CLUSTER_PWRDN>;
		};

		idle-states {
			CPU_PWRDN: cpu-power-down {
				compatible = "arm,idle-state";
				arm,psci-suspend-param = <0x0000001>;
				entry-latency-us = <10>;
				exit-latency-us = <10>;
				min-residency-us = <100>;
			};

			CLUSTER_RET: cluster-retention {
				compatible = "arm,idle-state";
				arm,psci-suspend-param = <0x1000011>;
				entry-latency-us = <500>;
				exit-latency-us = <500>;
				min-residency-us = <2000>;
			};

			CLUSTER_PWRDN: cluster-power-down {
				compatible = "arm,idle-state";
				arm,psci-suspend-param = <0x1000031>;
				entry-latency-us = <2000>;
				exit-latency-us = <2000>;
				min-residency-us = <6000>;
			};
	};

	psci {
		compatible = "arm,psci-0.2";
		method = "smc";
	};

Example 2: Hierarchical representation of CPU and domain idle states

	cpus {
		#address-cells = <1>;
		#size-cells = <0>;

		CPU0: cpu@0 {
			device_type = "cpu";
			compatible = "arm,cortex-a53", "arm,armv8";
			reg = <0x0>;
			enable-method = "psci";
			power-domains = <&CPU_PD0>;
			power-domain-names = "psci";
		};

		CPU1: cpu@1 {
			device_type = "cpu";
			compatible = "arm,cortex-a57", "arm,armv8";
			reg = <0x100>;
			enable-method = "psci";
			power-domains = <&CPU_PD1>;
			power-domain-names = "psci";
		};

		idle-states {
			CPU_PWRDN: cpu-power-down {
				compatible = "arm,idle-state";
				arm,psci-suspend-param = <0x0000001>;
				entry-latency-us = <10>;
				exit-latency-us = <10>;
				min-residency-us = <100>;
			};

			CLUSTER_RET: cluster-retention {
				compatible = "domain-idle-state";
				arm,psci-suspend-param = <0x1000010>;
				entry-latency-us = <500>;
				exit-latency-us = <500>;
				min-residency-us = <2000>;
			};

			CLUSTER_PWRDN: cluster-power-down {
				compatible = "domain-idle-state";
				arm,psci-suspend-param = <0x1000030>;
				entry-latency-us = <2000>;
				exit-latency-us = <2000>;
				min-residency-us = <6000>;
			};
		};
	};

	psci {
		compatible = "arm,psci-1.0";
		method = "smc";

		CPU_PD0: cpu-pd0 {
			#power-domain-cells = <0>;
			domain-idle-states = <&CPU_PWRDN>;
			power-domains = <&CLUSTER_PD>;
		};

		CPU_PD1: cpu-pd1 {
			#power-domain-cells = <0>;
			domain-idle-states =  <&CPU_PWRDN>;
			power-domains = <&CLUSTER_PD>;
		};

		CLUSTER_PD: cluster-pd {
			#power-domain-cells = <0>;
			domain-idle-states = <&CLUSTER_RET>, <&CLUSTER_PWRDN>;
		};
	};

[1] Kernel documentation - ARM idle states bindings
    Documentation/devicetree/bindings/arm/idle-states.txt
[2] Power State Coordination Interface (PSCI) specification
    http://infocenter.arm.com/help/topic/com.arm.doc.den0022c/DEN0022C_Power_State_Coordination_Interface.pdf
[3]. PM Domains description
    Documentation/devicetree/bindings/power/power_domain.txt
```

## Documentation/devicetree/bindings/clock/qcom,lpasscc.txt
```
Qualcomm LPASS Clock Controller Binding
-----------------------------------------------

Required properties :
- compatible		: shall contain "qcom,sdm845-lpasscc"
- #clock-cells		: from common clock binding, shall contain 1.
- reg			: shall contain base register address and size,
			  in the order
			Index-0 maps to LPASS_CC register region
			Index-1 maps to LPASS_QDSP6SS register region
- qcom,lpass-protected	: Boolean property to indicate to GCC clock controller
			 for the lpass GCC clocks.

Optional properties :
- reg-names	: register names of LPASS domain
		 "lpass_cc", "lpass_qdsp6ss".

Example:

The below node has to be defined in the cases where the LPASS peripheral loader
would bring the subsystem out of reset.

	lpasscc: clock-controller {
		compatible = "qcom,sdm845-lpasscc";
		reg = <0x17014000 0x1f004>, <0x17300000 0x200>;
		reg-names = "lpass_cc", "lpass_qdsp6ss";
		#clock-cells = <1>;
	};

	gcc: clock-controller@100000 {
		compatible = "qcom,gcc-sdm845";
		qcom,lpass-protected;
	};
```

## Documentation/devicetree/bindings/devfreq/devfreq-cpufreq-map.txt
```
Devfreq CPUfreq governor

devfreq-cpufreq-map is a parent device that contains one or more child devices.
Each child device provides CPU frequency to device frequency mapping for a
specific device. Examples of devices that could use this are: DDR, cache and
CCI.

Parent device name shall be "devfreq-cpufreq-map".

Required child device properties:
- cpu-to-dev-map, or cpu-to-dev-map-<X>:
			A list of tuples where each tuple consists of a
			CPU frequency (KHz) and the corresponding device
			frequency. CPU frequencies not listed in the table
			will use the device frequency that corresponds to the
			next rounded up CPU frequency.
			Use "cpu-to-dev-map" if all CPUs in the system should
			share same mapping.
			Use cpu-to-dev-map-<cpuid> to describe different
			mappings for different CPUs. The property should be
			listed only for the first CPU if multiple CPUs are
			synchronous.
- target-dev:		Phandle to device that this mapping applies to.

Example:
	devfreq-cpufreq-map {
		cpubw-cpufreq {
			target-dev = <&cpubw>;
			cpu-to-dev-map =
				<  300000  1144000 >,
				<  422400  2288000 >,
				<  652800  3051000 >,
				<  883200  5996000 >,
				< 1190400  8056000 >,
				< 1497600 10101000 >,
				< 1728000 12145000 >,
				< 2649600 16250000 >;
		};

		cache-cpufreq {
			target-dev = <&cache>;
			cpu-to-dev-map =
				<  300000  300000 >,
				<  422400  422400 >,
				<  652800  499200 >,
				<  883200  576000 >,
				<  960000  960000 >,
				< 1497600 1036800 >,
				< 1574400 1574400 >,
				< 1728000 1651200 >,
				< 2649600 1728000 >;
		};
	};
```

## Documentation/devicetree/bindings/devfreq/icbw.txt
```
Interconnect bandwidth device

icbw is a device that represents an interconnect path that connects two
devices. This device is typically used to vote for BW requirements between
two devices. Eg: CPU to DDR, GPU to DDR, etc

Required properties:
- compatible:		Must be "devfreq-icbw"
- interconnects:	Pairs of phandles and interconnect provider specifier
			to denote the edge source and destination ports of
			the interconnect path. See also:
		Documentation/devicetree/bindings/interconnect/interconnect.txt
- operating-points-v2:  A phandle to an OPP v2 table that holds meaningful
			bandwidth values (in MB/s) that can be requested for
			the interconnect path. The list of meaningful
			bandwidth values depend on multiple propertied of
			each segment of the interconnect path like list of
			supported frequencies, interconnect width,
			interconnect architecture, etc.

Example:

        bw_opp_table: bw-opp-table {
                compatible = "operating-points-v2";
                opp-75  {
                        opp-hz = /bits/ 64 <  572 >; /*  75 MHz */
                };
                opp-150 {
                        opp-hz = /bits/ 64 < 1144 >; /* 150 MHz */
                };
                opp-200 {
                        opp-hz = /bits/ 64 < 1525 >; /* 200 MHz */
                };
                opp-307 {
                        opp-hz = /bits/ 64 < 2342 >; /* 307 MHz */
                };
                opp-460 {
                        opp-hz = /bits/ 64 < 3509 >; /* 460 MHz */
                };
                opp-614 {
                        opp-hz = /bits/ 64 < 4684 >; /* 614 MHz */
                };
                opp-800 {
                        opp-hz = /bits/ 64 < 6103 >; /* 800 MHz */
                };
                opp-931 {
                        opp-hz = /bits/ 64 < 7102 >; /* 931 MHz */
                };
        };

	cpubw {
		compatible = "devfreq-icbw";
		interconnects = <&snoc MASTER_APSS_1 &bimc SLAVE_EBI_CH0>;
                operating-points-v2 = <&bw_opp_table>;
	};
```
