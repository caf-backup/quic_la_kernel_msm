## Documentation/devicetree/bindings/qca/wlan.txt
```
QCA WLAN Driver
---------------

This driver adds support for the WLAN subsystem for supporting
integrated WLAN module

Required properties:
  - compatible = "qca,wifi-qca961x";

Optional properties:

Example:

	wifi0: wifi@a000000 {
	   compatible = "qca,wifi-qca961x";
	   reg = <0xa000000 0x200000>;
	   resets = <&gcc WIFI0_CPU_INIT_RESET>,
		  <&gcc WIFI0_RADIO_SRIF_RESET>,
		  <&gcc WIFI0_RADIO_WARM_RESET>,
		  <&gcc WIFI0_RADIO_COLD_RESET>,
		  <&gcc WIFI0_CORE_WARM_RESET>,
		  <&gcc WIFI0_CORE_COLD_RESET>;
	   reset-names = "wifi_cpu_init",
	       "wifi_radio_srif",
	       "wifi_radio_warm",
	       "wifi_radio_cold",
	       "wifi_core_warm",
	       "wifi_core_cold";
	   /* TBD: Check if 'clocks' entry is required here - if required, add the entries once they are defined in GCC driver */
	   interrupts = <0 0x20 0x1>,
		      <0 0x21 0x1>,
		      <0 0x22 0x1>,
		      <0 0x23 0x1>,
		      <0 0x24 0x1>,
		      <0 0x25 0x1>,
		      <0 0x26 0x1>,
		      <0 0x27 0x1>,
		      <0 0x28 0x1>,
		      <0 0x29 0x1>,
		      <0 0x2a 0x1>,
		      <0 0x2b 0x1>,
		      <0 0x2c 0x1>,
		      <0 0x2d 0x1>,
		      <0 0x2e 0x1>,
		      <0 0x2f 0x1>,
		      <0 0xa8 0x0>;
	   interrupt-names = "msi0", "msi1", "msi2", "msi3", "msi4", "msi5", "msi6",
	       "msi7", "msi8", "msi9", "msi10", "msi11", "msi12", "msi13", "msi14",
	       "msi15", "legacy";
	   status = "disabled";
	   qca,msi_addr = <0x0b006040>;
	   qca,msi_base = <0x40>;
       };`
```

## Documentation/devicetree/bindings/rng/qcom,prng.txt
```
Qualcomm MSM pseudo random number generator.

Required properties:

- compatible  : should be "qcom,prng"
- reg         : specifies base physical address and size of the registers map
- clocks      : phandle to clock-controller plus clock-specifier pair
- clock-names : "core" clocks all registers, FIFO and circuits in PRNG IP block
- qcom,no-prng-config : Skip prng configuration if its done on secure side
- qcom,bandwidth-min  : to feed minimum bandwidth value
- qcom,bandwidth-max  : to feed maximum bandwidth value

Example:

	rng@f9bff000 {
		compatible = "qcom,prng";
		reg = <0xf9bff000 0x200>;
		clocks = <&clock GCC_PRNG_AHB_CLK>;
		clock-names = "core";
		qcom,no-prng-config;
		qcom,bandwidth-min = <0>;
		qcom,bandwidth-max = <800>;
	};
```

## Documentation/devicetree/bindings/soc/qcom/cpu_power_domain.txt
```
Qualcomm Technologies cpu power domain
-----------------------------------------

CPU power domain handles the tasks that need to be performed during
application processor deeper low power mode entry for QCOM SoCs which
have hardened IP blocks combinedly called as RPMH (Resource Power Manager
Hardened) for shared resource management. Flushing the buffered requests
to TCS (Triggered Command Set) in RSC (Resource State Coordinator) and
programming the wakeup timer in PDC (Power Domain Controller) for timer
based wakeup are handled as part of domain power down.

The bindings for cpu power domain is specified in the RSC section in
devicetree.

Properties:
- compatible:
	Usage: required
	Value type: <string>
	Definition: must be "qcom,cpu-pm-domain".

- #power-domain-cells: number of cells in power domain specifier;
    must be 0.

Node of a device using power domains must have a power-domains property
defined with a phandle to respective power domain.

Example:

	apps_rsc: rsc@179c0000 {
		[...]
		cpu_pd: power-domain-controller {
			compatible = "qcom,cpu-pm-domain";
			#power-domain-cells = <0>;
		};
	};


See Documentation/devicetree/bindings/power/power_domain.txt for description
of consumer-side bindings.
```

## Documentation/devicetree/bindings/soc/qcom/qca,tz_log.txt
```
QCA TZ_LOG

The tz_log driver is used to provide tz diagnostic information
to the user space.

Required properties:
- compatible: must contain "qca,tz_log" for IPQ40xx

Example for ipq40xx:

tzlog {
	compatible = "qca,tz_log";
};
```

## Documentation/devicetree/bindings/soc/qcom/qca,tz_log_ipq806x.txt
```
QCA TZ_LOG_IPQ806X

The tz_log driver is used to provide tz diagnostic information
to the user space. This binding is specifically used
to make the driver compatible for ipq806x.

Required properties:
- compatible: must contain "qca,tz_log_ipq806x" for IPQ806x

Example for ipq806x:

tzlog {
	        compatible = "qca,tz_log_ipq806x";
};
```

## Documentation/devicetree/bindings/soc/qcom/system_pm.txt
```
System PM
---------

System PM device handles the tasks that need to be performed during application
processor deeper low power mode entry for QCOM SoCs which have hardened IP blocks
combinedly called as RPMH (Resource Power Manager Hardened) for shared resource
management. System PM is a client of APPS_RSC. Flushing the buffered requests to
TCSs in RSC and programming the wakeup timer in PDC for timer based wakeup are
handled by this device.

The bindings for System PM is specified in the RSC section in devicetree.

Properties:
- compatible:
	Usage: required
	Value type: <string>
	Definition: must be "qcom,system-pm".

Example:

	apps_rsc: rsc@179c0000 {
		[...]
		system_pm {
			compatible = "qcom,system-pm";
		};
	};
```

## Documentation/devicetree/bindings/spi/qcom,spi-qcom-qspi.txt
```
Qualcomm Quad Serial Peripheral Interface (QSPI)

The QSPI controller allows SPI protocol communication in single, dual, or quad
wire transmission modes for read/write access to slaves such as NOR flash.

Required properties:
- compatible:	Should contain:
		"qcom,sdm845-qspi"
- reg:		Should contain the base register location and length.
- interrupts:	Interrupt number used by the controller.
- clocks:	Should contain the core and AHB clock.
- clock-names:	Should be "core" for core clock and "iface" for AHB clock.

SPI slave nodes must be children of the SPI master node and can contain
properties described in Documentation/devicetree/bindings/spi/spi-bus.txt

Example:

	qspi: qspi@88df000 {
		compatible = "qcom,sdm845-qspi";
		reg = <0x88df000 0x600>;
		#address-cells = <1>;
		#size-cells = <0>;
		interrupts = <GIC_SPI 82 IRQ_TYPE_LEVEL_HIGH>;
		clock-names = "iface", "core";
		clocks = <&gcc GCC_QSPI_CNOC_PERIPH_AHB_CLK>,
			 <&gcc GCC_QSPI_CORE_CLK>;

		device@0 {
			compatible = "jedec,spi-nor";
			reg = <0>;
			spi-max-frequency = <25000000>;
			spi-tx-bus-width = <2>;
			spi-rx-bus-width = <2>;
		};
	};
```

## drivers/coresight/Kconfig
```kconfig
menuconfig CORESIGHT
	bool "CoreSight Tracing Support"
	help
	  CoreSight components are compliant with the ARM CoreSight
	  architecture specification and can be connected in various
	  topologies to suite a particular SoCs tracing needs. These trace
	  components can generally be classified as sources, links and
	  sinks. Trace data produced by one or more sources flows through
	  the intermediate links connecting the source to the currently
	  selected sink.

	  This framework provides an interface for the CoreSight debug and
	  trace drivers to register themselves with. It's intended to build
	  up a topological view of the CoreSight components and configure
	  the right series of components on user input via sysfs. It also
	  provides status information to user space applications through
	  sysfs interface.

	  If unsure, say 'N' here to avoid potential power, performance and
	  memory penalty.

if CORESIGHT

config HAVE_CORESIGHT_SINK
	bool

if HAVE_CORESIGHT_SINK

config CORESIGHT_STM_DEFAULT_ENABLE
	bool "Turn on STM tracing by default"
	depends on CORESIGHT_STM
	help
	  Turns on CoreSight STM tracing (hardware assisted software
	  instrumentation based tracing) by default. Otherwise, tracing is
	  disabled by default but can be enabled via sysfs.

	  If unsure, say 'N' here to avoid potential power and performance
	  penalty.

config CORESIGHT_ETM_DEFAULT_ENABLE
	bool "Turn on ETM tracing by default"
	depends on CORESIGHT_ETM
	help
	  Turns on CoreSight ETM tracing (processor tracing) by default.
	  Otherwise, tracing is disabled by default but can be enabled via
	  sysfs.

	  If unsure, say 'N' here to avoid potential power and performance
	  penalty.

config CORESIGHT_ETM_PCSAVE_DEFAULT_ENABLE
	bool "Turn on PC saving by default"
	depends on CORESIGHT_ETM
	help
	  Turns on program counter saving on reset by default. Otherwise,
	  PC saving is disabled by default but can be enabled via sysfs.

	  If unsure, say 'N' here to avoid potential power penalty.

endif
endif
```

## drivers/soc/qcom/Kconfig
```kconfig
#
# QCOM Soc drivers
#
config QCOM_GSBI
        tristate "QCOM General Serial Bus Interface"
        depends on ARCH_QCOM
        help
          Say y here to enable GSBI support.  The GSBI provides control
          functions for connecting the underlying serial UART, SPI, and I2C
          devices to the output pins.

config QCOM_SCM
        bool

config QCOM_TCSR
        tristate "QCOM Top Control and Status Registers"
        depends on ARCH_QCOM
        help
          Say y here to enable TCSR support.  The TCSR provides control
          functions for various peripherals.

config QCOM_RESTART_REASON
        bool "Write restart reason on reboot"
        depends on ARCH_QCOM
        help
          Say y here to enable writing restart reason. This adds a reboot handler
          to write the restart reason command to distinguish between normal and
          abnormal reboots. This also registers for panic notification so that
          magic cookies can be set for download mode.
          If unsure, say N

config QCOM_DLOAD_MODE
        bool "Enable download mode on crashes"
        depends on ARCH_QCOM
        default n
        help
          This makes the SoC enter download mode when it resets
          due to a kernel panic. Note that this doesn't by itself
          make the kernel reboot on a kernel panic - that must be
          enabled via another mechanism.
          If unsure, say N

config QCOM_DLOAD_MODE_APPSBL
        bool "Application bootloader based download mode handling"
        depends on QCOM_DLOAD_MODE
        default n
        help
          Select this if application bootloader, for example U-Boot, will handle
          download mode due to kernel panic.
          If unsure, say N
```
