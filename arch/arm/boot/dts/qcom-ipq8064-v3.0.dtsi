/* Copyright (c) 2015, The Linux Foundation. All rights reserved.
 *
 * Permission to use, copy, modify, and/or distribute this software for any
 * purpose with or without fee is hereby granted, provided that the above
 * copyright notice and this permission notice appear in all copies.
 *
 * THE SOFTWARE IS PROVIDED "AS IS" AND THE AUTHOR DISCLAIMS ALL WARRANTIES
 * WITH REGARD TO THIS SOFTWARE INCLUDING ALL IMPLIED WARRANTIES OF
 * MERCHANTABILITY AND FITNESS. IN NO EVENT SHALL THE AUTHOR BE LIABLE FOR
 * ANY SPECIAL, DIRECT, INDIRECT, OR CONSEQUENTIAL DAMAGES OR ANY DAMAGES
 * WHATSOEVER RESULTING FROM LOSS OF USE, DATA OR PROFITS, WHETHER IN AN
 * ACTION OF CONTRACT, NEGLIGENCE OR OTHER TORTIOUS ACTION, ARISING OUT OF
 * OR IN CONNECTION WITH THE USE OR PERFORMANCE OF THIS SOFTWARE.
 *
 */

#include "qcom-ipq8064-v2.0.dtsi"
/ {
	cpus {
		 cpu@0 {
			operating-points-0-0 = <
				/* kHz      uV */
				1725000 1250000
				1400000 1200000
				1000000 1150000
				 800000 1100000
				 600000 1050000
				 384000 1000000
			>;
			operating-points-0-1 = <
				/* kHz      uV */
				1725000 1175000
				1400000 1125000
				1000000 1075000
				 800000 1025000
				 600000  975000
				 384000  925000
			>;
			operating-points-0-2 = <
				/* kHz      uV */
				1725000 1125000
				1400000 1075000
				1000000 1025000
				 800000  975000
				 600000  925000
				 384000  875000
			>;
			operating-points-0-3 = <
				/* kHz      uV */
				1725000 1050000
				1400000 1000000
				1000000  950000
				 800000  900000
				 600000  850000
				 384000  800000
			>;
		 };

		 cpu@1 {
		    	operating-points-0-0 = <
				/* kHz      uV */
				1725000 1250000
				1400000 1200000
				1000000 1150000
				 800000 1100000
				 600000 1050000
				 384000 1000000
			>;
			operating-points-0-1 = <
				/* kHz      uV */
				1725000 1175000
				1400000 1125000
				1000000 1075000
				 800000 1025000
				 600000  975000
				 384000  925000
			>;
			operating-points-0-2 = <
				/* kHz      uV */
				1725000 1125000
				1400000 1075000
				1000000 1025000
				 800000  975000
				 600000  925000
				 384000  875000
			>;
			operating-points-0-3 = <
				/* kHz      uV */
				1725000 1050000
				1400000 1000000
				1000000  950000
				 800000  900000
				 600000  850000
				 384000  800000
			>;
		};
	};
};
